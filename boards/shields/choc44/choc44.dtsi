left_encoder: encoder_left {
    compatible = "alps,ec11";
    a-gpios = <&gpio 2 (GPIO_ACTIVE_HIGH | GPIO_PULL_UP)>;
    b-gpios = <&gpio 3 (GPIO_ACTIVE_HIGH | GPIO_PULL_UP)>;
    steps = <80>;
    status = "disabled";
};
