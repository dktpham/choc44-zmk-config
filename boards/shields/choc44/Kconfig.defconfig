## boards/shields/choc44/Kconfig.defconfig
```kconfig
# Copyright (c) 2021 The ZMK Contributors
# SPDX-License-Identifier: MIT

if SHIELD_CHOC44

config ZMK_KEYBOARD_NAME
    default "Choc44"

endif
```

## boards/shields/choc44/Kconfig.shield
```kconfig
# Copyright (c) 2021 The ZMK Contributors
# SPDX-License-Identifier: MIT

config SHIELD_CHOC44
    def_bool $(shields_list_contains,choc44)
```
